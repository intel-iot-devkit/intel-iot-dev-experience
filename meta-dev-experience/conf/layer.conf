## meta-dev-experience/conf/layer.conf
```bitbake
# We have a conf and classes directory, append to BBPATH
BBPATH .= ":${LAYERDIR}"

# We have a recipes directory, add to BBFILES
BBFILES += "${LAYERDIR}/recipes*/*/*.bb ${LAYERDIR}/recipes*/*/*.bbappend"

BBFILE_COLLECTIONS += "dev-exp"
BBFILE_PATTERN_dev-exp := "^${LAYERDIR}/"
BBFILE_PRIORITY_dev-exp = "1000"

BB_ALLOWED_NETWORKS += "*.mosquitto.org *.org *.net *.com *.sourceforge.net download.sourceforge.net *.python.org *.mpfr.org *.gnome.org *.cairographics.org *.gnome.org *.gmplib.org *.gnu.org *.zlib.net *.freedesktop.org *.sqlite.org"



IMAGE_INSTALL_append += 'mosquitto'
IMAGE_INSTALL_append += 'hdc-solution'
IMAGE_INSTALL_append += 'node-macaddress'
IMAGE_INSTALL_append += 'node-red-experience'
IMAGE_INSTALL_append += 'node-xml2json'
IMAGE_INSTALL_append += 'node-global-tunnel'
IMAGE_INSTALL_append += 'node-mongodb'
IMAGE_INSTALL_append += 'nodejs-npm'
IMAGE_INSTALL_append += 'node-cloudcmd'
```

## meta-iot-developer-hub/conf/layer.conf
```bitbake
# We have a conf and classes directory, add to BBPATH
BBPATH := "${LAYERDIR}:${BBPATH}"

# We have a packages directory, add to BBFILES
BBFILES := "${BBFILES} ${LAYERDIR}/recipes-*/*.bb \
            ${LAYERDIR}/recipes-*/*.bbappend"

BBFILE_COLLECTIONS += "intel_repo_gui"
BBFILE_PATTERN_intel_repo_gui := "^${LAYERDIR}/"
BBFILE_PRIORITY_intel_repo_gui = "1000"

# We have a pre-populated downloads directory, add to PREMIRRORS
PREMIRRORS_append := "\
     git://.*/.* file://${LAYERDIR}/downloads/ \n \
     svn://.*/.* file://${LAYERDIR}/downloads/ \n \
     ftp://.*/.* file://${LAYERDIR}/downloads/ \n \
     http://.*/.* file://${LAYERDIR}/downloads/ \n \
     https://.*/.* file://${LAYERDIR}/downloads/ \n"
     
IMAGE_INSTALL_append += "cherrypy"
IMAGE_INSTALL_append += "pexpect"
IMAGE_INSTALL_append += "routes"
IMAGE_INSTALL_append += "simplejson"
IMAGE_INSTALL_append += "iot-developer-hub"    
IMAGE_INSTALL_append += "dh-rfs" 
```
